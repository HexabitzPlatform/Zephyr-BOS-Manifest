## boards/Hexabitz/H01R0/H01R0_defconfig
```kconfig
# Copyright (c) 2025 Hexabitz
# SPDX-License-Identifier: Apache-2.0

# Enable MPU
CONFIG_ARM_MPU=y

# Serial Drivers
CONFIG_SERIAL=y
CONFIG_UART_ASYNC_API=y
CONFIG_UART_INTERRUPT_DRIVEN=y
CONFIG_RING_BUFFER=y

# enable console
CONFIG_CONSOLE=y
CONFIG_UART_CONSOLE=y

# GPIO Controller
CONFIG_GPIO=y

# enable shared IRQs
CONFIG_SHARED_INTERRUPTS=y
CONFIG_SHARED_IRQ_MAX_NUM_CLIENTS=4

# enable PWM
CONFIG_PWM=y
CONFIG_PWM_STM32=y
```

## boards/Hexabitz/H01R0/Kconfig.H01R0
```kconfig
# Copyright (c) 2025 Hexabitz
# SPDX-License-Identifier: Apache-2.0

config BOARD_H01R0
	select SOC_STM32G0B1XX
```

## boards/Hexabitz/H01R0/board.yml
```yaml
# Copyright (c) 2024 Nordic Semiconductor ASA
# SPDX-License-Identifier: Apache-2.0

board:
  name: H01R0
  vendor: Hexabitz
  socs:
    - name: stm32g0b1xx
```

## dts/bindings/hexabitz/bos.yaml
```yaml
description: Hexabitz BOS node
compatible: "hexabitz,bos"

include: base.yaml

properties:
  modulePN:
    type: int
    required: true
    description: Hexabitz module part number

  number-ports:
    type: int
    required: true
    description: Number of ports

  
```

## dts/bindings/hexabitz/port-mapping.yaml
```yaml
description: Hexabitz dynamic port mapping

compatible: "hexabitz,port-mapping"

properties:
  ports:
    type: phandle-array
    required: true
    description: List of UART devices used for each logical port. Each referenced node must define #port-cells.

  port-names:
    type: string-array
    required: true
    description: Names for each logical port. Must match the number of ports.

  label:
    type: string
    required: false
    description: Optional label for the port mapping node.
```
