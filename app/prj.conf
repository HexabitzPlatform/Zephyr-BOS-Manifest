## CMakeLists.txt
```
#-------------------------------------------------------------------------------
# Zephyr Example Application
#
# Copyright (c) 2021 Nordic Semiconductor ASA
# SPDX-License-Identifier: Apache-2.0

cmake_minimum_required(VERSION 3.20.0)
find_package(Zephyr REQUIRED HINTS $ENV{ZEPHYR_BASE})

project(app LANGUAGES C)

target_sources(app PRIVATE src/main.c)

#add_subdirectory(BOS)
```

## prj.conf
```kconfig
# Copyright (c) 2021 Nordic Semiconductor ASA
# SPDX-License-Identifier: Apache-2.0
#
# This file contains selected Kconfig options for the application.

#CONFIG_SENSOR=y
#CONFIG_BLINK=y
```

## src/main.c
```c
#include <BOS.h>

void UserTask(void)
{
    UARTInit();

    led_init();

    SwapUartPins(GetUart(P1), REVERSED);

    while (1)
    {
        // led_blink(60);

        led_toggle();
        k_msleep(500);
    }
}
```
